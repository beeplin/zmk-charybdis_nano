## config/west.yml
```yaml
manifest:
  remotes:
    - name: beeplin
      url-base: https://github.com/beeplin
    - name: inorichi
      url-base: https://github.com/inorichi
  projects:
    - name: zmk
      remote: beeplin
      revision: feat/pointers-move-scroll
      import: app/west.yml
    - name: zmk-pmw3610-driver
      remote: inorichi
      revision: main
  self:
    path: config
```
